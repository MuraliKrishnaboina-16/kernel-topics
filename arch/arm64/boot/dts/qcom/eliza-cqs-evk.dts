// SPDX-License-Identifier: BSD-3-Clause
/*
 * Copyright (c) Qualcomm Technologies, Inc. and/or its subsidiaries.
 */

/dts-v1/;

#include "eliza-cqs-som.dtsi"
#include "eliza-evk.dtsi"

/ {
	model = "Qualcomm Technologies, Inc. Eliza CQS EVK";
	compatible = "qcom,eliza-cqs-evk", "qcom,eliza-cqs-som", "qcom,eliza";
};

&tlmm {
	gpio-reserved-ranges = <20 4>,   /* NFC SPI */
			       <111 2>,  /* WCN UART1 */
			       <118 1>;  /* NFC Secure I/O */
};
